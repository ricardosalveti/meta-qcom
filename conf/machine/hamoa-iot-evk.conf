## conf/machine/hamoa-iot-evk.conf
```bitbake
#@TYPE: Machine
#@NAME: Qualcomm Hamoa-IOT Evaluation Kit (EVK)
#@DESCRIPTION: Machine configuration for Qualcomm Hamoa-IOT Evaluation Kit (EVK)

require conf/machine/include/qcom-hamoa-iot.inc

MACHINE_FEATURES += "efi pci"

QCOM_DTB_DEFAULT ?= "hamoa-iot-evk"

KERNEL_DEVICETREE ?= " \
                      qcom/hamoa-iot-evk.dtb \
                      "

MACHINE_ESSENTIAL_EXTRA_RRECOMMENDS += " \
    packagegroup-hamoa-iot-evk-firmware \
    packagegroup-hamoa-iot-evk-hexagon-dsp-binaries \
"

##NEED TO REVIEW THESE VALUES
QCOM_CDT_FILE = "IQ_X_EVK_CDT"
QCOM_BOOT_FILES_SUBDIR = "hamoa-iot-evk"
QCOM_PARTITION_FILES_SUBDIR ?= "partitions/hamoa-iot-evk/ufs"

QCOM_BOOT_FIRMWARE = "firmware-qcom-boot-hamoa-iot-evk"
```
